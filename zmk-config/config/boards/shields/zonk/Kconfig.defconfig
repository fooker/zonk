## zmk-config/config/boards/shields/zonk/Kconfig.defconfig
```kconfig
# Copyright (c) 2022 The ZMK Contributors
# SPDX-License-Identifier: MIT

if SHIELD_ZONK

config ZMK_KEYBOARD_NAME
    default "ZONK"
    
endif
```
